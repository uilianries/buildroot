## package/blink-led/Config.in
```kconfig
config BR2_PACKAGE_BLINK_LED
    bool "blink-led"
    help
        Blink a LED using Wiring Pi.

        http://example.com
```

## package/oled96/Config.in
```kconfig
config BR2_PACKAGE_OLED96
	bool "oled96"
	depends on BR2_TOOLCHAIN_HAS_THREADS
	depends on !BR2_STATIC_LIBS
	help
	  A simple C library (Linux + Arduino) for drawing text
	  and graphics on SSD1306/SH1106 OLED displays.

	  https://github.com/bitbank2/oled_96

comment "oled96 needs a toolchain w/ dynamic library"
	depends on !BR2_TOOLCHAIN_HAS_THREADS || BR2_STATIC_LIBS
```

## package/rpi-oled-example/Config.in
```kconfig
config BR2_PACKAGE_RPI_OLED_EXAMPLE
    bool "rpi-old-example"
    help
        Show "Hello World on OLED display for RaspberryPi"

        http://example.com
```

## package/rpi-wifi-startup/Config.in
```kconfig
config BR2_PACKAGE_RPI_WIFI_STARTUP
    bool "rpi-wifi-startup"
    depends on BR2_PACKAGE_RPI_WIFI_FIRMWARE 
    depends on BR2_PACKAGE_DROPBEAR
    depends on BR2_PACKAGE_WIRELESS_TOOLS
    depends on BR2_PACKAGE_WPA_SUPPLICANT
    depends on BR2_PACKAGE_WPA_SUPPLICANT_NL80211
    depends on BR2_PACKAGE_WPA_SUPPLICANT_PASSPHRASE

    help
      Raspberry Pi 3 and Zero W - wifi startup service
```
